## firmware/zmk/config/boards/shields/aff314modkeeb/Kconfig.defconfig
```kconfig
if SHIELD_AFF314MODKEEB

config ZMK_KEYBOARD_NAME
    default "AFF314MODKEEB"

endif
```

## firmware/zmk/config/boards/shields/aff314modkeeb/Kconfig.shield
```kconfig
config SHIELD_AFF314MODKEEB
    def_bool $(shields_list_contains, aff314modkeeb)
```
